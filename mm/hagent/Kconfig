## mm/hagent/Kconfig
```kconfig
config HAGENT
	tristate "Heterogeneous memory agent"
	default m
	depends on RUST
	select BTREE
	select PRIME_NUMBERS
	help
	  Enable heterogeneous memory guest agent to rebalance memory across different memory media.
```

## mm/memtis/Kconfig
```kconfig
config HTMM
	bool "Enable hugepage-aware tiered memory management"
	depends on MIGRATION && TRANSPARENT_HUGEPAGE && MEMCG
	help
	  Enable memory access sampling and dynamic placement for
	  tiered memory systems (DRAM + NVM). This optimizes the system
	  performance in tiered memory systems by coordinating transparent
	  hugepage support with tiered memory management.

	  If in doubt, say N.
```

## mm/nimble/Kconfig
```kconfig
config PAGE_MIGRATION_PROFILE
	bool "Page migration profile"
	def_bool n
	help
	  Profile migrate hugepages with multiple optimizations to get higher throughput.

config NIMBLE_PAGE_MANAGEMENT
	bool "Nimble page management option. It selects required kernel modules."
	def_bool y
	select ARCH_ENABLE_THP_MIGRATION
	select TRANSPARENT_HUGEPAGE
	select MEMCG
	select MEMCG_SWAP
	select DYNAMIC_DEBUG
```
